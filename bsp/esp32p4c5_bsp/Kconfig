## bsp/esp32p4c5_bsp/Kconfig
```kconfig
menu "Board Support Package (KSDIY ESP32-P4/C5)"

    config BSP_ERROR_CHECK
        bool "Enable error check in BSP"
        default y
        help
            Error check assert the application before returning the error code.

    menu "I2C"
        config BSP_I2C_NUM
            int "I2C peripheral index"
            default 0
            range 0 1
            help
                ESP32-P4 has two I2C peripherals, pick the one you want to use.
                Touch, PMIC, audio codecs, IMU and camera SCCB all sit on this bus.

        config BSP_I2C_FAST_MODE
            bool "Enable I2C fast mode"
            default y
            help
                I2C has two speed modes: normal (100kHz) and fast (400kHz).

        config BSP_I2C_CLK_SPEED_HZ
            int
            default 400000 if BSP_I2C_FAST_MODE
            default 100000
    endmenu

    menu "PMIC (AXP2101)"
        config BSP_PMIC_SET_CHARGER
            bool "Program the battery charger in bsp_battery_init()"
            default n
            help
                Off: keep the charge current and voltage already in the AXP2101 (its defaults,
                or what an earlier program wrote). On: write the values below. Pick them from
                the battery datasheet; a charge current above the battery rating is unsafe.

        config BSP_PMIC_CHARGE_CURRENT_MA
            int "Constant charge current (mA)"
            depends on BSP_PMIC_SET_CHARGER
            range 200 1000
            default 500
            help
                Rounded down to the charger step (100 mA from 200 mA up).

        choice BSP_PMIC_CHARGE_VOLTAGE
            prompt "Charge target voltage"
            depends on BSP_PMIC_SET_CHARGER
            default BSP_PMIC_CHARGE_VOLTAGE_4V20
            config BSP_PMIC_CHARGE_VOLTAGE_4V10
                bool "4.10 V"
            config BSP_PMIC_CHARGE_VOLTAGE_4V20
                bool "4.20 V (standard Li-ion / LiPo)"
            config BSP_PMIC_CHARGE_VOLTAGE_4V35
                bool "4.35 V (high voltage LiPo)"
            config BSP_PMIC_CHARGE_VOLTAGE_4V40
                bool "4.40 V (high voltage LiPo)"
        endchoice

        config BSP_PMIC_CHARGE_VOLTAGE_REG
            int
            depends on BSP_PMIC_SET_CHARGER
            default 2 if BSP_PMIC_CHARGE_VOLTAGE_4V10
            default 3 if BSP_PMIC_CHARGE_VOLTAGE_4V20
            default 4 if BSP_PMIC_CHARGE_VOLTAGE_4V35
            default 5 if BSP_PMIC_CHARGE_VOLTAGE_4V40
    endmenu

    menu "Audio (I2S0)"
        config BSP_I2S_DMA_DESC_NUM
            int "I2S DMA buffers per direction"
            default 6
            range 2 16
            help
                Number of DMA buffers of the speaker (TX) and of the microphones (RX) each.

        config BSP_I2S_DMA_FRAME_NUM
            int "Frames per I2S DMA buffer"
            default 240
            range 32 511
            help
                One frame = one sample of every slot. The buffers are internal DMA RAM:
                DESC_NUM x FRAME_NUM x bytes per frame, per direction. Bytes per frame is
                2 for 16-bit mono, 4 for 16-bit stereo, 8 for the microphone frame
                (BSP_MIC_CHANNELS x BSP_MIC_BITS): 6 x 240 x 8 = 11.25 KB per direction.

        config BSP_AUDIO_INIT_MIC_FRAME
            bool "bsp_audio_init(NULL) starts with the microphone frame (2 x 32 bit)"
            default y
            help
                The I2S driver frees and allocates its DMA buffers again whenever a codec is
                opened with a frame of another size (16-bit music after the 2 x 32-bit
                microphone, and back). Starting with the widest frame makes the first, largest
                allocation happen in bsp_audio_init(), early, while internal RAM is still free.
                Off: start with 16-bit mono (smallest buffers, the behaviour up to v0.3.0).
    endmenu

    menu "4G modem (ML307C)"
        config BSP_MODEM_UART_NUM
            int "UART port of the modem"
            default 1
            range 1 4
            help
                UART0 is the console (CH343P), so the modem uses another port.
    endmenu

    menu "SPIFFS"
        config BSP_SPIFFS_FORMAT_ON_MOUNT_FAIL
            bool "Format SPIFFS if mounting fails"
            default n

        config BSP_SPIFFS_MOUNT_POINT
            string "SPIFFS mount point"
            default "/spiffs"

        config BSP_SPIFFS_PARTITION_LABEL
            string "Partition label of SPIFFS"
            default "storage"

        config BSP_SPIFFS_MAX_FILES
            int "Max files supported for SPIFFS VFS"
            default 5
    endmenu

    menu "microSD card"
        config BSP_SD_MOUNT_POINT
            string "Mount point of the microSD card in the VFS"
            default "/sdcard"
    endmenu

    menu "Display"
        choice BSP_LCD_COLOR_FORMAT
            prompt "Select LCD color format"
            default BSP_LCD_COLOR_FORMAT_RGB565
            help
                Pixel format of the MIPI DPI frame buffer.
                It must match the LVGL color depth (RGB565 = 16 bit, RGB888 = 24 bit);
                a mismatch is rejected at compile time.

            config BSP_LCD_COLOR_FORMAT_RGB565
                bool "RGB565"
            config BSP_LCD_COLOR_FORMAT_RGB888
                bool "RGB888"
        endchoice

        config BSP_DISPLAY_BRIGHTNESS_LEDC_CH
            int "LEDC channel index"
            default 1
            range 0 7
            help
                LEDC channel is used to generate PWM signal that controls display brightness.
                Set LEDC index that should be used.

        config BSP_DISPLAY_LVGL_TASK_STACK_SIZE
            int "LVGL task stack size (bytes)"
            default 16384
            range 4096 131072
            help
                Stack size of the LVGL task created by bsp_display_start().
    endmenu

endmenu
```
